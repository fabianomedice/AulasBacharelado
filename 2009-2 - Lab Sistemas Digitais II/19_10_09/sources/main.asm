
					XDEF Entry,main


					Include 'qtqy_registers.inc'    ; For the QT1, QT2, QT4, QY1, QY2, QY4
;CONSTANTES
t50ms EQU 31249

DEFAULT_RAM				SECTION SHORT    
TEMPO DS 1
 
DEFAULT_ROM				SECTION


Entry:
main:
	MOV #$09 ,CONFIG1
	MOV #$40 ,CONFIG2
	MOV #0, DDRA
	MOV #$FF ,PTAPUE
	MOV #$FF, DDRB
	MOV #0, INTSCR
	;MOV #$30, TSC
	;LDHX #50000
	;STHX TMOD 
	
MODO: 	LDA PORTA ;CONFERIR QUAL O MODO DE MANHA
		AND #2
		BNE NORMAL
		
FERIADO: MOV #$11,PORTB; PVERMELHO LIGADO E CVERDE LIGADO

NORMAL: MOV #$11, PORTB ;LIGANDO PVERMELHO E CVERDE
		  MOV #$6,TEMPO ;TEMPO 6S
		  BSR TIME
		  MOV #$12, PORTB ; LIGANDO PVERMELHOR E CAMARELO
		  MOV #$2,TEMPO ;TEMPO 2S
		  BSR TIME
		  MOV #$0C, PORTB ;LIGANDO PVERDE E CVERMELHO
		  MOV #$4,TEMPO ;TEMPO 4S
		  BSR TIME
		  BRA MODO
		  
NOTURNO: MOV #$12, PORTB; LIGANDO PVERMELHO E CAMARELO
		    MOV #$1,TEMPO;TEMPO 1 S
		    BSR TIME
		    MOV #0, PORTB; DESLIGADO
		    MOV #$1,TEMPO ;TEMPO 1 S
		    BSR TIME	
      
     
PEDESTRE: MOV #$12,PORTB ;LIGAR CAMARELO E PVERMELHO
		    MOV #$2,TEMPO ;TEMPO 2S
		    BSR TIME
		     MOV #$0C,PORTB ;LIGAR CVERMELHO E PVERDE
		     MOV #$4,TEMPO ;TEMPO 4S
		     BSR TIME
		     RTI



TIME:       
D1S: 	LDA 20
L1: 		LDHX #t50ms
L0:		AIX #-1
		CPHX #0
		BNE L0
		DECA
		BNE L1
		DEC TEMPO
		BNE TIME
		RTS
		     


END  

