

					XDEF main


					Include 'qtqy_registers.inc'    ; For the QT1, QT2, QT4, QY1, QY2, QY4

          

DEFAULT_RAM				SECTION SHORT    

VARDELAY: DS 1
TEMPOSINAL: DS 1
STATUSTEMPO: DS 1
STATUSPORTA: DS 1
; Place RAM Variables here
 
DEFAULT_ROM				SECTION
main
		MOV #$40, CONFIG2; COM IRQ, SEM RESET E 3,2 MHZ
		
		MOV #$39, CONFIG1; SEM LVI, COP, STOP E + 5VOLTS
		MOV #$28,DDRA; PTA5, PTA4 E PTA3 SAIDAS
		MOV #3, PTAPUE; Duas resistencias de pull UP
		MOV #0, PORTA
		CLR INTSCR
		CLI
		


LERCHAVE: LDA PORTA; A =    X X VERDE AMARELO VERMELHO X X CH1 CH0
		  AND #3   ; #1=    0 0   0      0        0    0 0  1   1
		           ; A = 0  0 0   0      0        0    0 0 CH1 CH0
		           
		           
		  BEQ TEMP0
		  DECA
		  BEQ TEMP1
		  DECA
		  BEQ PISCAAMARELO

FIXAVERDE: MOV #$20, PORTA
		   BRA LERCHAVE
		   
PISCAAMARELO:  SWI
			
		
				BRA LERCHAVE 
PISCA:
        MOV #$28,PORTA
        BSR D1SEG
        MOV #$0,PORTA
        BSR D1SEG 
        BRCLR 1,PORTA,SAI
        BRCLR 0,PORTA,PISCA
        ;SE CH1CHO=10 CONTINUA PISCANDO SE NAO SAI
        ;BRA LERCHAVE
        RTI				
		            
		
TEMP0:		
VERDE:	MOV #$20, PORTA; ACENDE
		MOV #5, TEMPOSINAL
		
LVERDE: BSR D1SEG; CHAMA A SUBROTINA D1SEG MARCANDO O PONTO DE RETORNO
		DEC TEMPOSINAL
		BNE LVERDE


AMARELO: MOV #$28, PORTA; ACENDE
		MOV #2, TEMPOSINAL
		
LAMARELO: BSR D1SEG; CHAMA A SUBROTINA D1SEG MARCANDO O PONTO DE RETORNO
		DEC TEMPOSINAL
		BNE LAMARELO
		
		
VERMELHO MOV #$8, PORTA; ACENDE
		MOV #3, TEMPOSINAL
				
LVERMELHO: BSR D1SEG; CHAMA A SUBROTINA D1SEG MARCANDO O PONTO DE RETORNO
			DEC TEMPOSINAL
			BNE LVERMELHO		
      BRA LERCHAVE		


TEMP1:
VERDE1:	MOV #$20, PORTA; ACENDE
		MOV #3, TEMPOSINAL
		
LVERDE1: BSR D1SEG; CHAMA A SUBROTINA D1SEG MARCANDO O PONTO DE RETORNO
		DEC TEMPOSINAL
		BNE LVERDE1


AMARELO1: MOV #$28, PORTA; ACENDE
		MOV #1, TEMPOSINAL
		
LAMARELO1: BSR D1SEG; CHAMA A SUBROTINA D1SEG MARCANDO O PONTO DE RETORNO
		DEC TEMPOSINAL
		BNE LAMARELO1
		
		
VERMELHO1 MOV #$8, PORTA; ACENDE
		MOV #4, TEMPOSINAL
				
LVERMELHO1: BSR D1SEG; CHAMA A SUBROTINA D1SEG MARCANDO O PONTO DE RETORNO
			DEC TEMPOSINAL
			BNE LVERMELHO1
      BRA LERCHAVE


D1SEG:    MOV #100, VARDELAY
D10MILI:  LDA #100      ;D10MILI и A SUBROTINA QUE ENVOLVE UM LOOP COM OUTRO LOOP DENTRO (D100MICRO)
D100MICRO:LDX #80       ;LOOP DENTRO DA SUBROTINA
LOOP:	  DECX			;DECREMENTO X - LOOP DENTRO DO LOOP
		  BNE LOOP		;DESVIA SE O RESULTADO FOR DIFERENTE DE ZERO
		  DECA          ;DECREMENTA O A
		  BNE D100MICRO ;DESVIA PARA A D100MICRO
		  DEC VARDELAY
		  BNE D10MILI
		  RTS			;RETORNA DA SUBROTINA
      
PEDESTRE: 
      MOV PORTA,STATUSPORTA
      MOV TEMPOSINAL,STATUSTEMPO
      MOV #$8,PORTA; VERMELHO
      MOV #3,TEMPOSINAL
LPE:  BSR D1SEG
      DBNZ TEMPOSINAL,LPE      
      MOV STATUSTEMPO,TEMPOSINAL
      MOV STATUSPORTA,PORTA
      
      RTI
SAI:              
      ORG $FFFC
      DC.W PISCA
      ORG $FFFA
      DC.W PEDESTRE
END  

