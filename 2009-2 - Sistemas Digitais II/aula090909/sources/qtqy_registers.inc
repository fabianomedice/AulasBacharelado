PORTA	EQU $0000
PORTB	EQU $0001
DDRA    EQU $0004
DDRB	EQU $0005
PTAPUE  EQU $000B
PTBPUE  EQU $000C

KBSCR   EQU $001A
KBIER   EQU $001B

INTSCR	EQU $001D

CONFIG2 EQU $001E
CONFIG1 EQU $001F

TSC	EQU $0020
TCNTH	EQU $0021
TCNTL	EQU $0022
TMODH	EQU $0023
TMODL	EQU $0024
TSC0	EQU $0025
TCH0H	EQU $0026
TCH0L	EQU $0027
TSC1	EQU $0028
TCH1H	EQU $0029
TCH1L	EQU $002A

OSCSTAT EQU $0036
OSCTRIM EQU $0037

ADSCR	EQU $003C
ADR	    EQU $003E
ADICLK  EQU $003F

BSR	EQU $FE00
SRSR	EQU $FE01
BRKAR	EQU $FE02
BFCR	EQU $FE03
INT1	EQU $FE04
INT2	EQU $FE05
INT3	EQU $FE06
FLCR	EQU $FE08
BRKH	EQU $FE09
BRKL	EQU $FE0A
BRKSCR	EQU $FE0B
LVISR	EQU $FE0c
FLBPR	EQU $FFBE
IOSCTRM EQU $FFC0

COPCTL	EQU $FFFF


